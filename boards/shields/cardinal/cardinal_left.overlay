#include "cardinal.dtsi" // Notice that the main dtsi files are included in the overlay.

&kscan_6_column {
    col-gpios
        = <&pro_micro 21 GPIO_ACTIVE_HIGH> // col-1 in the schematic
        , <&pro_micro 20 GPIO_ACTIVE_HIGH> 
        , <&pro_micro 19 GPIO_ACTIVE_HIGH> 
        , <&pro_micro 18 GPIO_ACTIVE_HIGH> 
        , <&pro_micro 15 GPIO_ACTIVE_HIGH> 
        , <&pro_micro 14 GPIO_ACTIVE_HIGH> 
        ;
};

//Map for snapped column, the same due to thumb-1
&kscan_5_column {
    col-gpios
        = <&pro_micro 21 GPIO_ACTIVE_HIGH> // col-1 in the schematic
        , <&pro_micro 20 GPIO_ACTIVE_HIGH> 
        , <&pro_micro 19 GPIO_ACTIVE_HIGH> 
        , <&pro_micro 18 GPIO_ACTIVE_HIGH> 
        , <&pro_micro 15 GPIO_ACTIVE_HIGH> 
        , <&pro_micro 14 GPIO_ACTIVE_HIGH> 
        ;
};

&encoder_left_h {
    status = "okay";
};

&encoder_left_v {
    status = "okay";
};
