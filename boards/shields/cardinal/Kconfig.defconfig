## boards/shields/cardinal/Kconfig.defconfig
```kconfig
# Copyright (c) 2020 The ZMK Contributors
# SPDX-License-Identifier: MIT

if SHIELD_CARDINAL_LEFT

config ZMK_KEYBOARD_NAME
	default "Cardinal"

config ZMK_SPLIT_BLE_ROLE_CENTRAL
	default y

endif

if SHIELD_CARDINAL_LEFT || SHIELD_CARDINAL_RIGHT

config ZMK_SPLIT
	default y

if ZMK_DISPLAY & !SHIELD_NICE_VIEW

config I2C
    default y

config SSD1306
    default y

config SSD1306_REVERSE_MODE
    default y

endif # ZMK_DISPLAY

if LVGL & !SHIELD_NICE_VIEW

config LV_Z_VDB_SIZE
    default 64

config LV_Z_DPI
    default 148

config LV_Z_BITS_PER_PIXEL
    default 1

choice LV_COLOR_DEPTH
    default LV_COLOR_DEPTH_1
endchoice

endif # LVGL

endif
```

## boards/shields/cardinal/Kconfig.shield
```kconfig
config SHIELD_CARDINAL_LEFT
	def_bool $(shields_list_contains,cardinal_left)

config SHIELD_CARDINAL_RIGHT
	def_bool $(shields_list_contains,cardinal_right)

config SHIELD_NICE_VIEW
	def_bool $(shields_list_contains,nice_view)
```

## config/west.yml
```yaml
manifest:
  remotes:
    - name: zmkfirmware
      url-base: https://github.com/zmkfirmware
    # Additional modules containing boards/shields/custom code can be listed here as well
    # See https://docs.zephyrproject.org/3.2.0/develop/west/manifest.html#projects
    - name: urob
      url-base: https://github.com/urob
  projects:
    - name: zmk
      remote: zmkfirmware
      revision: v0.3.0
      import: app/west.yml
    - name: zmk-helpers
      remote: urob
      revision: v2
  self:
    path: config
```
